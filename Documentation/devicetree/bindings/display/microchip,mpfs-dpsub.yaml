## arch/arm/configs/sama5d4ing_PROD_defconfig
```kconfig
CONFIG_CROSS_COMPILE="/opt/arm-islero-linux-gnueabi/bin/arm-islero-linux-gnueabi-"
# CONFIG_LOCALVERSION_AUTO is not set
# CONFIG_SWAP is not set
CONFIG_SYSVIPC=y
CONFIG_POSIX_MQUEUE=y
CONFIG_LOG_BUF_SHIFT=14
CONFIG_CGROUPS=y
CONFIG_CGROUP_FREEZER=y
CONFIG_CGROUP_DEVICE=y
CONFIG_CPUSETS=y
CONFIG_CGROUP_CPUACCT=y
CONFIG_RESOURCE_COUNTERS=y
CONFIG_CGROUP_SCHED=y
CONFIG_BLK_CGROUP=y
CONFIG_NAMESPACES=y
CONFIG_BLK_DEV_INITRD=y
# CONFIG_KALLSYMS is not set
# CONFIG_BUG is not set
CONFIG_EMBEDDED=y
CONFIG_PERF_EVENTS=y
# CONFIG_COMPAT_BRK is not set
CONFIG_SLAB=y
CONFIG_MODULES=y
CONFIG_MODULE_UNLOAD=y
# CONFIG_BLK_DEV_BSG is not set
CONFIG_PARTITION_ADVANCED=y
# CONFIG_IOSCHED_DEADLINE is not set
# CONFIG_IOSCHED_CFQ is not set
CONFIG_ARCH_AT91=y
CONFIG_SOC_SAM_V7=y
CONFIG_SOC_SAMA5D4=y
CONFIG_MACH_SAMA5_DT=y
CONFIG_AT91_TIMER_HZ=250
CONFIG_AEABI=y
# CONFIG_OABI_COMPAT is not set
CONFIG_UACCESS_WITH_MEMCPY=y
CONFIG_CC_STACKPROTECTOR=y
# CONFIG_ATAGS is not set
CONFIG_ZBOOT_ROM_TEXT=0x0
CONFIG_ZBOOT_ROM_BSS=0x0
CONFIG_VFP=y
CONFIG_NEON=y
# CONFIG_COREDUMP is not set
CONFIG_NET=y
CONFIG_PACKET=y
CONFIG_UNIX=y
CONFIG_INET=y
CONFIG_IP_MULTICAST=y
# CONFIG_INET_XFRM_MODE_TRANSPORT is not set
# CONFIG_INET_XFRM_MODE_TUNNEL is not set
# CONFIG_INET_XFRM_MODE_BEET is not set
# CONFIG_INET_LRO is not set
# CONFIG_IPV6 is not set
CONFIG_NETFILTER=y
CONFIG_NETFILTER_NETLINK_ACCT=y
CONFIG_NETFILTER_NETLINK_QUEUE=y
CONFIG_NF_CONNTRACK=y
# CONFIG_NF_CONNTRACK_PROCFS is not set
CONFIG_NF_CONNTRACK_EVENTS=y
CONFIG_NF_CONNTRACK_TIMEOUT=y
CONFIG_NF_CONNTRACK_TIMESTAMP=y
CONFIG_NETFILTER_NETLINK_QUEUE_CT=y
CONFIG_NETFILTER_XT_CONNMARK=y
CONFIG_NETFILTER_XT_TARGET_MARK=y
CONFIG_NETFILTER_XT_TARGET_NFLOG=y
CONFIG_NETFILTER_XT_MATCH_ADDRTYPE=m
CONFIG_NETFILTER_XT_MATCH_CONNLIMIT=m
CONFIG_NETFILTER_XT_MATCH_CONNMARK=m
CONFIG_NETFILTER_XT_MATCH_CONNTRACK=m
CONFIG_NETFILTER_XT_MATCH_IPRANGE=m
CONFIG_NETFILTER_XT_MATCH_LENGTH=m
CONFIG_NETFILTER_XT_MATCH_LIMIT=m
CONFIG_NETFILTER_XT_MATCH_MAC=m
CONFIG_NETFILTER_XT_MATCH_MARK=m
CONFIG_NETFILTER_XT_MATCH_MULTIPORT=m
CONFIG_NETFILTER_XT_MATCH_OSF=m
CONFIG_NETFILTER_XT_MATCH_OWNER=m
CONFIG_NETFILTER_XT_MATCH_PKTTYPE=m
CONFIG_NETFILTER_XT_MATCH_RECENT=m
CONFIG_NETFILTER_XT_MATCH_STATE=m
CONFIG_NETFILTER_XT_MATCH_STATISTIC=m
CONFIG_NETFILTER_XT_MATCH_STRING=m
CONFIG_NETFILTER_XT_MATCH_TCPMSS=m
CONFIG_NETFILTER_XT_MATCH_TIME=m
CONFIG_NF_CONNTRACK_IPV4=y
CONFIG_IP_NF_IPTABLES=y
CONFIG_IP_NF_FILTER=y
CONFIG_IP_NF_TARGET_REJECT=y
CONFIG_NF_NAT_IPV4=m
CONFIG_IP_NF_TARGET_REDIRECT=m
# CONFIG_WIRELESS is not set
CONFIG_UEVENT_HELPER_PATH="/sbin/hotplug"
CONFIG_DEVTMPFS=y
CONFIG_DEVTMPFS_MOUNT=y
# CONFIG_STANDALONE is not set
# CONFIG_PREVENT_FIRMWARE_BUILD is not set
CONFIG_CMA=y
CONFIG_CONNECTOR=y
CONFIG_MTD=y
CONFIG_MTD_BLOCK=y
CONFIG_MTD_NAND=y
CONFIG_MTD_NAND_ECC_BCH=y
CONFIG_MTD_NAND_ATMEL=y
CONFIG_MTD_UBI=y
CONFIG_MTD_UBI_FASTMAP=y
CONFIG_PROC_DEVICETREE=y
CONFIG_BLK_DEV_LOOP=y
CONFIG_BLK_DEV_RAM=y
CONFIG_BLK_DEV_RAM_COUNT=4
CONFIG_BLK_DEV_RAM_SIZE=8192
CONFIG_ATMEL_TCLIB=y
# CONFIG_ATMEL_TCB_CLKSRC is not set
CONFIG_SCSI=y
CONFIG_BLK_DEV_SD=y
# CONFIG_SCSI_LOWLEVEL is not set
CONFIG_NETDEVICES=y
CONFIG_MACB=y
# CONFIG_NET_VENDOR_BROADCOM is not set
# CONFIG_NET_VENDOR_CIRRUS is not set
# CONFIG_NET_VENDOR_FARADAY is not set
# CONFIG_NET_VENDOR_INTEL is not set
# CONFIG_NET_VENDOR_MARVELL is not set
# CONFIG_NET_VENDOR_MICREL is not set
# CONFIG_NET_VENDOR_NATSEMI is not set
# CONFIG_NET_VENDOR_SEEQ is not set
# CONFIG_NET_VENDOR_SMSC is not set
# CONFIG_NET_VENDOR_STMICRO is not set
# CONFIG_NET_VENDOR_WIZNET is not set
CONFIG_MICREL_PHY=y
CONFIG_PPP=m
CONFIG_PPP_BSDCOMP=m
CONFIG_PPP_DEFLATE=m
CONFIG_PPP_ASYNC=m
CONFIG_PPP_SYNC_TTY=m
# CONFIG_WLAN is not set
CONFIG_INPUT_MOUSEDEV=m
CONFIG_INPUT_EVDEV=y
CONFIG_INPUT_TOUCHSCREEN=y
CONFIG_VT_HW_CONSOLE_BINDING=y
CONFIG_LEGACY_PTY_COUNT=4
CONFIG_SERIAL_ATMEL=y
# CONFIG_HW_RANDOM is not set
CONFIG_GPIO_SYSFS=y
# CONFIG_HWMON is not set
CONFIG_VIDEO_OUTPUT_CONTROL=y
CONFIG_FB=y
CONFIG_FB_MODE_HELPERS=y
CONFIG_FB_SIMPLE=y
CONFIG_BACKLIGHT_LCD_SUPPORT=y
CONFIG_LCD_CLASS_DEVICE=y
CONFIG_BACKLIGHT_CLASS_DEVICE=y
# CONFIG_BACKLIGHT_GENERIC is not set
CONFIG_LOGO=y
# CONFIG_LOGO_LINUX_MONO is not set
# CONFIG_LOGO_LINUX_VGA16 is not set
# CONFIG_LOGO_LINUX_CLUT224 is not set
CONFIG_USB=y
CONFIG_USB_ANNOUNCE_NEW_DEVICES=y
CONFIG_USB_EHCI_HCD=y
CONFIG_USB_OHCI_HCD=y
CONFIG_USB_ACM=m
CONFIG_USB_STORAGE=y
CONFIG_USB_SERIAL=y
CONFIG_USB_GADGET=y
CONFIG_USB_ATMEL_USBA=m
CONFIG_USB_ZERO=m
CONFIG_USB_ETH=m
CONFIG_USB_G_NCM=m
CONFIG_USB_GADGETFS=m
CONFIG_USB_FUNCTIONFS=m
CONFIG_USB_MASS_STORAGE=m
CONFIG_USB_G_SERIAL=m
CONFIG_USB_CDC_COMPOSITE=m
CONFIG_USB_G_ACM_MS=m
CONFIG_MMC=y
# CONFIG_MMC_BLOCK_BOUNCE is not set
CONFIG_SDIO_UART=y
CONFIG_MMC_ATMELMCI=y
CONFIG_DMADEVICES=y
CONFIG_AT_XDMAC=y
# CONFIG_IOMMU_SUPPORT is not set
CONFIG_VFAT_FS=y
CONFIG_TMPFS=y
CONFIG_TMPFS_POSIX_ACL=y
CONFIG_UBIFS_FS=y
CONFIG_UBIFS_FS_ADVANCED_COMPR=y
# CONFIG_UBIFS_FS_ZLIB is not set
# CONFIG_NETWORK_FILESYSTEMS is not set
CONFIG_NLS_CODEPAGE_437=y
CONFIG_NLS_CODEPAGE_850=y
CONFIG_NLS_ISO8859_1=y
# CONFIG_SCHED_DEBUG is not set
# CONFIG_FTRACE is not set
# CONFIG_ARM_UNWIND is not set
CONFIG_CRYPTO_ECB=y
CONFIG_CRYPTO_CRC32C=y
CONFIG_CRYPTO_SHA1_ARM=y
CONFIG_CRYPTO_SHA256=y
CONFIG_CRYPTO_AES_ARM=y
CONFIG_CRYPTO_DES=y
CONFIG_CRYPTO_DEFLATE=y
# CONFIG_CRYPTO_ANSI_CPRNG is not set
# CONFIG_CRYPTO_HW is not set
CONFIG_CRC_ITU_T=m
CONFIG_XZ_DEC=y
# CONFIG_XZ_DEC_ARMTHUMB is not set
CONFIG_AVERAGE=y
```

## arch/arm/configs/sama7g5_fpga_defconfig
```kconfig
# CONFIG_LOCALVERSION_AUTO is not set
# CONFIG_SWAP is not set
CONFIG_SYSVIPC=y
# CONFIG_FHANDLE is not set
CONFIG_IRQ_DOMAIN_DEBUG=y
CONFIG_NO_HZ_IDLE=y
CONFIG_HIGH_RES_TIMERS=y
CONFIG_LOG_BUF_SHIFT=16
CONFIG_CGROUPS=y
CONFIG_CGROUP_DEBUG=y
CONFIG_NAMESPACES=y
CONFIG_SYSFS_DEPRECATED=y
CONFIG_SYSFS_DEPRECATED_V2=y
CONFIG_BLK_DEV_INITRD=y
CONFIG_EXPERT=y
CONFIG_KALLSYMS_ALL=y
# CONFIG_VM_EVENT_COUNTERS is not set
CONFIG_SLAB=y
# CONFIG_BLK_DEV_BSG is not set
CONFIG_PARTITION_ADVANCED=y
# CONFIG_EFI_PARTITION is not set
# CONFIG_IOSCHED_DEADLINE is not set
# CONFIG_IOSCHED_CFQ is not set
CONFIG_ARCH_AT91=y
CONFIG_SOC_SAMA7G5=y
# CONFIG_ARM_THUMB is not set
# CONFIG_KUSER_HELPERS is not set
# CONFIG_ARM_PATCH_IDIV is not set
CONFIG_OABI_COMPAT=y
# CONFIG_CPU_SW_DOMAIN_PAN is not set
# CONFIG_COMPACTION is not set
CONFIG_FORCE_MAX_ZONEORDER=15
CONFIG_UACCESS_WITH_MEMCPY=y
CONFIG_ZBOOT_ROM_TEXT=0x0
CONFIG_ZBOOT_ROM_BSS=0x0
CONFIG_CMDLINE="console=ttyS0,115200 earlyprintk nocache ignore_loglevel"
CONFIG_FPE_NWFPE=y
CONFIG_VFP=y
CONFIG_NEON=y
# CONFIG_COREDUMP is not set
# CONFIG_SUSPEND is not set
CONFIG_NET=y
CONFIG_PACKET=y
CONFIG_UNIX=y
CONFIG_INET=y
CONFIG_IP_MULTICAST=y
CONFIG_IP_PNP=y
# CONFIG_UEVENT_HELPER is not set
CONFIG_DEVTMPFS=y
CONFIG_DEVTMPFS_MOUNT=y
# CONFIG_STANDALONE is not set
# CONFIG_PREVENT_FIRMWARE_BUILD is not set
# CONFIG_FIRMWARE_IN_KERNEL is not set
# CONFIG_ALLOW_DEV_COREDUMP is not set
CONFIG_MTD=y
CONFIG_MTD_CMDLINE_PARTS=y
CONFIG_MTD_NAND=y
CONFIG_MTD_NAND_ATMEL=y
CONFIG_MTD_SPI_NOR=y
CONFIG_SPI_ATMEL_QUADSPI=y
CONFIG_BLK_DEV_LOOP=y
CONFIG_BLK_DEV_RAM=y
CONFIG_BLK_DEV_RAM_COUNT=1
CONFIG_BLK_DEV_RAM_SIZE=8192
CONFIG_ATMEL_TCLIB=y
CONFIG_NETDEVICES=y
CONFIG_MACB=y
# CONFIG_INPUT_KEYBOARD is not set
# CONFIG_INPUT_MOUSE is not set
# CONFIG_SERIO is not set
CONFIG_LEGACY_PTY_COUNT=4
CONFIG_SERIAL_ATMEL=y
CONFIG_SERIAL_ATMEL_CONSOLE=y
# CONFIG_HW_RANDOM is not set
CONFIG_PINCTRL_AT91=y
CONFIG_PINCTRL_AT91PIO4=y
CONFIG_GPIO_SYSFS=y
# CONFIG_HWMON is not set
# CONFIG_RC_CORE is not set
# CONFIG_HID is not set
# CONFIG_USB_SUPPORT is not set
CONFIG_MMC=y
CONFIG_MMC_SDHCI=y
CONFIG_MMC_SDHCI_PLTFM=y
CONFIG_MMC_SDHCI_OF_AT91=y
CONFIG_DMADEVICES=y
CONFIG_AT_XDMAC=y
CONFIG_DMATEST=y
CONFIG_ATMEL_PIT64=y
# CONFIG_IOMMU_SUPPORT is not set
# CONFIG_ATMEL_EBI is not set
CONFIG_EXT2_FS=y
CONFIG_EXT3_FS=y
CONFIG_FANOTIFY=y
CONFIG_TMPFS=y
CONFIG_CONFIGFS_FS=y
CONFIG_NFS_FS=y
CONFIG_ROOT_NFS=y
CONFIG_NLS=y
CONFIG_NLS_CODEPAGE_437=y
CONFIG_NLS_CODEPAGE_850=y
CONFIG_NLS_ISO8859_1=y
CONFIG_NLS_UTF8=y
CONFIG_PRINTK_TIME=y
CONFIG_MESSAGE_LOGLEVEL_DEFAULT=7
CONFIG_DEBUG_INFO=y
CONFIG_DEBUG_FS=y
CONFIG_DEBUG_MEMORY_INIT=y
# CONFIG_SCHED_DEBUG is not set
# CONFIG_FTRACE is not set
CONFIG_MEMTEST=y
CONFIG_DEBUG_USER=y
CONFIG_DEBUG_LL=y
CONFIG_DEBUG_UART_PHYS=0xe1818200
CONFIG_DEBUG_UART_VIRT=0xf1818200
CONFIG_EARLY_PRINTK=y
# CONFIG_CRYPTO_ECHAINIV is not set
CONFIG_CRYPTO_DEFLATE=y
CONFIG_CRYPTO_LZO=y
# CONFIG_CRYPTO_HW is not set
CONFIG_CRC_CCITT=y
CONFIG_CRC_ITU_T=y
```

## drivers/cache/Kconfig
```kconfig
# SPDX-License-Identifier: GPL-2.0
menu "Cache Drivers"

config AX45MP_L2_CACHE
	bool "Andes Technology AX45MP L2 Cache controller"
	depends on RISCV
	select RISCV_NONSTANDARD_CACHE_OPS
	help
	  Support for the L2 cache controller on Andes Technology AX45MP platforms.

config SIFIVE_CCACHE
	bool "Sifive Composable Cache controller"
	depends on ARCH_MICROCHIP_POLARFIRE || ARCH_SIFIVE || ARCH_STARFIVE
	depends on PERF_EVENTS
	help
	  Support for the composable cache controller on SiFive platforms.

config SIFIVE_ECACHE_PMU
	bool "Sifive Extensible Cache PMU"
	depends on ARCH_MICROCHIP_POLARFIRE || ARCH_SIFIVE || ARCH_STARFIVE
	depends on PERF_EVENTS
	help
	  Support for the extensible cache pmu on SiFive platforms.
	  SiFive extensible cache is shared by all cores. User can
	  use the perf tool to select the extensible cache pmu events
	  to monitor program or whole system cache performance.

config SIFIVE_PL2
	bool "Sifive private L2 Cache controller"
	depends on ARCH_MICROCHIP_POLARFIRE || ARCH_SIFIVE || ARCH_STARFIVE
	depends on PERF_EVENTS
	default y
	help
	  Support for the private L2 cache controller on SiFive platforms.

endmenu
```

## drivers/gpu/drm/microchip/Kconfig
```kconfig
# SPDX-License-Identifier: GPL-2.0-only
config DRM_MICROCHIP_GFX2D
	tristate "DRM support for Microchip GFX2D GPU"
	depends on DRM && OF && COMMON_CLK && ARM
	help
	  Choose this option if you have a Microchip SoC with a GFX2D GPU
	  (i.e. SAM9X60 or SAM9X7 families). The GFX2D supports basic 2D
	  graphics instructions, each working on a single rectangle defined
	  by its width and height plus the coordinates of its top-left
	  corner in each of the surface (behind a DRM GEM object) involved
	  in the graphics instructions. There are four types of graphics
	  instructions:
	  - FILL: the rectangle is filled in the target surface with a
	  uniform color.
	  - COPY: the rectangle is copied from a single source surface into
	  the target surface.
	  - BLEND: the rectangle in the target surface is the result of a
	  blending from rectangles of the same size in two source surfaces.
	  - ROP: the rectangle in the target surface is the result of a
	  raster operation on two (ROP2), three (ROP3), or four (ROP4)
	  source surfaces, depending on the selected raster mode.

config DRM_MPFS_DPSUB
	tristate "Microchip Display Controller Driver"
	depends on ARCH_MICROCHIP_POLARFIRE || COMPILE_TEST
	depends on COMMON_CLK && DRM && OF
	depends on DMADEVICES
	select DRM_CLIENT_SELECTION
	select DMA_ENGINE
	select VIDEOMODE_HELPERS
	select DRM_DISPLAY_HELPER
	select DRM_BRIDGE_CONNECTOR
	select DRM_GEM_DMA_HELPER
	select DRM_KMS_HELPER
	select GENERIC_PHY
	help
	  This is a DRM/KMS driver for Microchip Display Controller. Choose
	  this option if you have a Microchip Polarfire SoC with Display
	  Controller subsystem.
```

## drivers/iio/mpfs-mc/Kconfig
```kconfig
# SPDX-License-Identifier: GPL-2.0-only
#
# MPFS Motor Control IIO drivers
#

menu "MPFS Motor Control"

config IIO_MPFS_MC_ADC
	tristate "MPFS Motor Control ADC Driver"
	depends on OF
	select IIO_BUFFER
	select IIO_KFIFO_BUF
	help
	  Say yes here to build support for the MPFS Motor Control ADC driver.
	  This driver provides IIO interface for motor ADC with current sensing,
	  overcurrent threshold configuration, and buffered data acquisition
	  for BLDC and Stepper motor control applications.

	  To compile this driver as a module, choose M here: the
	  module will be called mpfs_mc_adc.

config IIO_MPFS_MC_PICON
	tristate "MPFS Motor Control PI Controller Driver"
	depends on OF
	help
	  Say yes here to build support for the MPFS Motor Control PI Controller driver.
	  This driver provides IIO interface for PI (Proportional-Integral) controller
	  configuration for motor control closed-loop operation.

	  To compile this driver as a module, choose M here: the
	  module will be called mpfs_mc_picon.

config IIO_MPFS_MC_PWM
	tristate "MPFS Motor Control PWM Driver"
	depends on OF
	help
	  Say yes here to build support for the MPFS Motor Control PWM driver.
	  This driver provides IIO interface for PWM (Pulse Width Modulation)
	  control of BLDC and Stepper motors.

	  To compile this driver as a module, choose M here: the
	  module will be called mpfs_mc_pwm.

config IIO_MPFS_MC_RATELIM
	tristate "MPFS Motor Control Rate Limiter Driver"
	depends on OF
	help
	  Say yes here to build support for the MPFS Motor Control Rate Limiter driver.
	  This driver provides IIO interface for acceleration/deceleration rate
	  limiting of motor speed changes.

	  To compile this driver as a module, choose M here: the
	  module will be called mpfs_mc_ratelim.

config IIO_MPFS_MC_SQMNG
	tristate "MPFS Motor Control Sequencer Manager Driver"
	depends on OF
	help
	  Say yes here to build support for the MPFS Motor Control Sequencer Manager driver.
	  This driver provides IIO interface for motor sequencer finite state machine
	  control including start, stop, and fault management.

	  To compile this driver as a module, choose M here: the
	  module will be called mpfs_mc_sqmng.

config IIO_MPFS_MC_STPTHETA
	tristate "MPFS Motor Control Stepper Theta Driver"
	depends on OF
	help
	  Say yes here to build support for the MPFS Motor Control Stepper Theta driver.
	  This driver provides IIO interface for stepper motor position (theta)
	  control and configuration.

	  To compile this driver as a module, choose M here: the
	  module will be called mpfs_mc_stptheta.

config IIO_MPFS_MC
	tristate "MPFS Motor Control Drivers (BLDC/Stepper)"
	select IIO_MPFS_MC_ADC
	select IIO_MPFS_MC_PICON
	select IIO_MPFS_MC_PWM
	select IIO_MPFS_MC_RATELIM
	select IIO_MPFS_MC_SQMNG
	select IIO_MPFS_MC_STPTHETA
	help
	  Say yes here to build all MPFS Motor Control drivers for BLDC and Stepper
	  motor applications. This option selects all motor control IIO drivers
	  including ADC, PI controller, PWM, rate limiter, sequence manager, and
	  stepper theta modules.

	  To compile these drivers as modules, choose M here.

endmenu
```

## drivers/soc/sifive/Kconfig
```kconfig
# SPDX-License-Identifier: GPL-2.0

if SOC_SIFIVE

config SIFIVE_WGCHECKER
	bool "Sifive world guard checker"
	default y
	help
	  Provide driver for worldguard checkers. This driver registers
	  interrupt handler for each WorldGuard Checker appears on the DT, and
	  only reports, but do not handle the first access violation to the
	  protected range.

endif
```
