## Documentation/devicetree/bindings/display/microchip,mpfs-dpsub.yaml
```yaml
# SPDX-License-Identifier: (GPL-2.0-only OR BSD-2-Clause)
%YAML 1.2
---
$id: http://devicetree.org/schemas/display/microchip,mpfs-dpsub.yaml#
$schema: http://devicetree.org/meta-schemas/core.yaml#

title: MPFS Display Subsystem

description: The Display subsystem of MPFS implements the display pipeline.

maintainers:
  - Shravan chippa <shravan.chippa@microchip.com>

properties:
  compatible:
    enum:
      - microchip,mpfs-dpsub-2.0

  reg:
    items:
      - description: Primary plane (required)
      - description: Display controller (required)
      - description: Overlay plane (optional)
      - description: Cursor plane (optional)
    minItems: 2
    maxItems: 4

  reg-names:
    items:
      - const: primary
      - const: display-controller
      - const: overlay
      - const: cursor
    minItems: 2

  interrupts:
    minItems: 1
    maxItems: 1

  clocks:
    items:
      - description: AXI Lite clock
      - description: Video frame clock
    minItems: 2
    maxItems: 2

  clock-names:
    items:
      - const: axi
      - const: video

  memory-region:
    description: Reserved memory for drm buffers (optional)
    maxItems: 1

required:
  - compatible
  - reg
  - reg-names
  - interrupts
  - clocks
  - clock-names

additionalProperties: false

examples:
  - |
      video-display-pipeline@6000a000 {
                  compatible = "microchip,mpfs-dpsub-2.0";
                  reg = <0x6000a000 0x1000>,
                        <0x6000c000 0x1000>,
                        <0x6000d000 0x1000>,
                        <0x6000e000 0x1000>;
                  reg-names = "primary", "display-controller", "overlay", "cursor";
                  interrupts = <120>;
                  clock-names = "axi", "video";
                  clocks = <&axi_clk_video_out_0>, <&video_clk_video_out_0>;
                  memory-region = <&fabric1disbuff1>;
      };

...
```

## Documentation/devicetree/bindings/iio/motor-control/microchip,mpfs-mc.yaml
```yaml
# SPDX-License-Identifier: (GPL-2.0-only OR BSD-2-Clause)
%YAML 1.2
---
$id: http://devicetree.org/schemas/iio/motor-control/microchip,mpfs-mc.yaml#
$schema: http://devicetree.org/meta-schemas/core.yaml#

title: Microchip PolarFire SoC (MPFS) Motor Control IIO

maintainers:
  - Sunny Bezawda <sunny.bezawada@microchip.com>

description: |
  The Microchip PolarFire SoC motor control subsystem provides IIO-based
  hardware blocks for driving BLDC and Stepper motors. Each block is exposed
  as a separate platform device with a memory-mapped register interface.

  The subsystem consists of:
    - ADC scaling: Multi-channel ADC with current sensing and overcurrent
      detection for BLDC and Stepper motor feedback.
    - PI controller: Speed and current (Id/Iq) PI controller for closed-loop
      motor regulation.
    - 3-phase PWM: PWM period, dead-time, delay, and gain configuration for
      three-phase motor drive.
    - Rate limiter: Rate limiting, slew control, and direction management for
      smooth motor operation.
    - Sequencer manager: Motor start/stop/fault sequencing and state machine
      control.
    - Stepper theta: Step position control with slew and rate limiting for
      stepper motors.

properties:
  compatible:
    enum:
      - microchip,adc-scaling-rtl-v4.3
      - microchip,speed-id-iq-pi-rtl-v4.2
      - microchip,pwm3ph-rtl-v4.2
      - microchip,rate-limiter-rtl-v4.2
      - microchip,seq-controller-rtl-v4.2
      - microchip,stepper-theta-rtl-v4.2

  reg:
    maxItems: 1

required:
  - compatible
  - reg

additionalProperties: false

examples:
  - |
    &fabric_bus {
      #address-cells = <2>;
      #size-cells = <2>;

      adc@60010000 {
        compatible = "microchip,adc-scaling-rtl-v4.3";
        reg = <0x0 0x60010000 0x0 0x400>;
      };

      pi-controller@60011000 {
        compatible = "microchip,speed-id-iq-pi-rtl-v4.2";
        reg = <0x0 0x60011000 0x0 0x400>;
      };

      pwm@60012000 {
        compatible = "microchip,pwm3ph-rtl-v4.2";
        reg = <0x0 0x60012000 0x0 0x400>;
      };

      rate-limiter@60013000 {
        compatible = "microchip,rate-limiter-rtl-v4.2";
        reg = <0x0 0x60013000 0x0 0x400>;
      };

      sequencer@60014000 {
        compatible = "microchip,seq-controller-rtl-v4.2";
        reg = <0x0 0x60014000 0x0 0x400>;
      };

      stepper-theta@60015000 {
        compatible = "microchip,stepper-theta-rtl-v4.2";
        reg = <0x0 0x60015000 0x0 0x400>;
      };
    };
```

## Documentation/devicetree/bindings/media/microchip,fpga-dscmi.yaml
```yaml
# SPDX-License-Identifier: (GPL-2.0-only OR BSD-2-Clause)
%YAML 1.2
---
$id: http://devicetree.org/schemas/media/microchip,fpga-dscmi.yaml#
$schema: http://devicetree.org/meta-schemas/core.yaml#

title: Microchip Digital Serial Camera Memory Interface

maintainers:
  - Shravan Chippa <shravan.chippa@microchip.com>

properties:
  compatible:
    const: microchip,fpga-dscmi

  reg:
    maxItems: 1

  interrupts:
    maxItems: 1

  dmas:
    maxItems: 1

  dma-names:
    items:
      - const: rx

  reset-gpios:
    maxItems: 1
    description: CSI2 module MIPI training reset

  memory-region:
    maxItems: 1

  port:
    $ref: /schemas/graph.yaml#/$defs/port-base
    unevaluatedProperties: false
    description:
      supports a single port node with CSI2 interface.

    properties:
      endpoint:
        $ref: /schemas/media/video-interfaces.yaml#
        unevaluatedProperties: false

required:
  - compatible
  - reg
  - interrupts
  - reset-gpios
  - memory-region
  - dmas
  - dma-names
  - port

additionalProperties: false

examples:
  - |
    #include <dt-bindings/gpio/gpio.h>

    mchp_dscmi_cam0: video-pipeline@40000000 {
        compatible = "microchip,fpga-dscmi";
        reg = <0x40000000 0x2000>;
        interrupt-parent = <&plic>;
        interrupts = <118>;
        reset-gpios = <&gpio2 4 GPIO_ACTIVE_HIGH>;
        memory-region = <&cambuf0>;
        dmas = <&pdma 0>;
        dma-names = "rx";
        port {
            mchp_dscmi_ep_cam0: endpoint {
                remote-endpoint = <&imx334_ep_cam0>;
               };
           };
      };

...
```

## Documentation/devicetree/bindings/net/microchip,coretsn-rtl-v2.yaml
```yaml
# SPDX-License-Identifier: (GPL-2.0-only OR BSD-2-Clause)
%YAML 1.2
---
$id: http://devicetree.org/schemas/net/microchip,coretsn-rtl-v2.yaml#
$schema: http://devicetree.org/meta-schemas/core.yaml#

title: Microchip Time Sensitive Network Device

description: |
  The Microchip CoreTSN IP implements Time Sensitive Networking protocols
  for Ethernet. Two RTL variants are supported:

  RTL v2 supports:
    - Traffic Shaping (IEEE 802.1Qbv)
    - Frame Preemption (IEEE 802.3br and IEEE 802.1Qbu)
    - Stream Filtering and Policing (IEEE 802.1Qci)

  RTL v3 extends the feature set with:
    - QBV with 64-bit cycle time, 8 priority queues, per-queue stream ID
      configuration, RX stream ID reset timeout, and FRER stream handling
    - QAV/CBS (Credit-Based Shaping)
    - Statistics counters
    - QCI/PSFP (Per-Stream Filtering and Policing)
    - Capability reporting for runtime ABI selection

  The driver uses a capability-gated extension model selected from devicetree
  compatible data. RTL v2 continues to support the original TSN configuration
  ABI. RTL v3 supports the extended TSN feature set without breaking v2
  userspace.

maintainers:
  - Pallela Venkat Karthik <pallela.karthik@microchip.com>

properties:
  compatible:
    enum:
      - microchip,coretsn-rtl-v2
      - microchip,coretsn-rtl-v3

  reg:
    description:
      Address and length of the IO space.
    maxItems: 1

  clocks:
    items:
      - description: Clock for AXI register slave interface.
      - description: Clock for CoreTSN IP.

  clock-names:
    items:
      - const: apb
      - const: core

required:
  - compatible
  - reg
  - clocks
  - clock-names

additionalProperties: false

examples:
  - |
    /* RTL v2 instance */
    tsn@40000000 {
        compatible = "microchip,coretsn-rtl-v2";
        reg = <0x40000000 0x1000>;
        clocks = <&clkcfg 30>, <&tsnclk>;
        clock-names = "apb", "core";
    };
  - |
    /* RTL v3 instance with extended TSN feature set */
    tsn@40004000 {
        compatible = "microchip,coretsn-rtl-v3";
        reg = <0x40004000 0x1000>;
        clocks = <&clkcfg 30>, <&tsnclk>;
        clock-names = "apb", "core";
    };
```

## Documentation/devicetree/bindings/riscv/sifive,pl2cache0.yaml
```yaml
# SPDX-License-Identifier: (GPL-2.0 OR BSD-2-Clause)
# Copyright (C) 2023 SiFive, Inc.
%YAML 1.2
---
$id: http://devicetree.org/schemas/riscv/sifive,pl2cache0.yaml#
$schema: http://devicetree.org/meta-schemas/core.yaml#

title: SiFive Private L2 Cache Controller

maintainers:
  - Greentime Hu  <greentime.hu@sifive.com>
  - Eric Lin      <eric.lin@sifive.com>

description:
  The SiFive Private L2 Cache Controller is per hart and communicates with both the upstream
  L1 caches and downstream L3 cache or memory, enabling a high-performance cache subsystem.
  All the properties in ePAPR/DeviceTree specification applies for this platform.

allOf:
  - $ref: /schemas/cache-controller.yaml#

select:
  properties:
    compatible:
      contains:
        enum:
          - sifive,pl2cache0
          - sifive,pl2cache1

  required:
    - compatible

properties:
  compatible:
    items:
      - enum:
          - sifive,pl2cache0
          - sifive,pl2cache1

  cache-block-size:
    const: 64

  cache-level:
    const: 2

  cache-sets:
    const: 512

  cache-size:
    const: 262144

  cache-unified: true

  reg:
    maxItems: 1

  next-level-cache: true

additionalProperties: false

required:
  - compatible
  - cache-block-size
  - cache-level
  - cache-sets
  - cache-size
  - cache-unified
  - reg

examples:
  - |
    pl2@10104000 {
        compatible = "sifive,pl2cache0";
        cache-block-size = <64>;
        cache-level = <2>;
        cache-sets = <512>;
        cache-size = <262144>;
        cache-unified;
        reg = <0x10104000 0x4000>;
        next-level-cache = <&L4>;
    };
```

## Documentation/devicetree/bindings/soc/sifive/sifive,wgchecker2.yaml
```yaml
# SPDX-License-Identifier: (GPL-2.0-only OR BSD-2-Clause)
%YAML 1.2
---
$id: http://devicetree.org/schemas/sifive/sifive,wgchecker2.yaml#
$schema: http://devicetree.org/meta-schemas/core.yaml#

title: SiFive WorldGuard Checker

maintainers:
  - Andy Chiu <andy.chiu@sifive.com>

description: |
  The driver for SiFive WorldGuard Checker only reports the first violation
  interrupt when it happens. It do not try to set or read wg checker themselves
  because Linux should not runs in a secure wid and accessing any wg MMIO region
  from a non-secure wid is prohibited by the spec.

properties:
  compatible:
    items:
      - const: sifive,wgchecker2

  reg:
    maxItems: 1
    description: |
      The MMIO base address of the wg checker. Since we are not programming wg
      checkers in Linux, we do not really need this information.

  interrupts:
    maxItems: 1
    description: |
      The interrupt number which the wg checker generates. Must be edge trigger.

required:
  - compatible
  - interrupts

additionalProperties: false
...
```

## arch/arm/configs/sama5d4ing-bootstrap_defconfig
```kconfig
CONFIG_CROSS_COMPILE="/opt/arm-islero-linux-gnueabi/bin/arm-islero-linux-gnueabi-"
# CONFIG_LOCALVERSION_AUTO is not set
# CONFIG_SWAP is not set
CONFIG_SYSVIPC=y
CONFIG_IKCONFIG=y
CONFIG_IKCONFIG_PROC=y
CONFIG_LOG_BUF_SHIFT=14
CONFIG_CGROUPS=y
CONFIG_CGROUP_FREEZER=y
CONFIG_CGROUP_DEVICE=y
CONFIG_CPUSETS=y
CONFIG_CGROUP_CPUACCT=y
CONFIG_RESOURCE_COUNTERS=y
CONFIG_CGROUP_SCHED=y
CONFIG_BLK_CGROUP=y
CONFIG_NAMESPACES=y
CONFIG_SYSFS_DEPRECATED=y
CONFIG_SYSFS_DEPRECATED_V2=y
CONFIG_BLK_DEV_INITRD=y
CONFIG_KALLSYMS_ALL=y
CONFIG_EMBEDDED=y
CONFIG_SLAB=y
CONFIG_MODULES=y
CONFIG_MODULE_UNLOAD=y
# CONFIG_BLK_DEV_BSG is not set
CONFIG_PARTITION_ADVANCED=y
# CONFIG_IOSCHED_DEADLINE is not set
# CONFIG_IOSCHED_CFQ is not set
CONFIG_ARCH_AT91=y
CONFIG_SOC_SAM_V7=y
CONFIG_SOC_SAMA5D4=y
CONFIG_MACH_SAMA5_DT=y
CONFIG_AEABI=y
# CONFIG_OABI_COMPAT is not set
CONFIG_UACCESS_WITH_MEMCPY=y
CONFIG_ZBOOT_ROM_TEXT=0x0
CONFIG_ZBOOT_ROM_BSS=0x0
CONFIG_VFP=y
CONFIG_NEON=y
# CONFIG_COREDUMP is not set
# CONFIG_SUSPEND is not set
CONFIG_UEVENT_HELPER_PATH="/sbin/hotplug"
CONFIG_DEVTMPFS=y
CONFIG_DEVTMPFS_MOUNT=y
# CONFIG_STANDALONE is not set
# CONFIG_PREVENT_FIRMWARE_BUILD is not set
CONFIG_MTD=y
CONFIG_MTD_BLOCK=y
CONFIG_MTD_NAND=y
CONFIG_MTD_NAND_ECC_BCH=y
CONFIG_MTD_NAND_ATMEL=y
CONFIG_MTD_UBI=y
CONFIG_PROC_DEVICETREE=y
CONFIG_BLK_DEV_LOOP=y
CONFIG_BLK_DEV_RAM=y
CONFIG_BLK_DEV_RAM_COUNT=4
CONFIG_BLK_DEV_RAM_SIZE=32768
CONFIG_ATMEL_TCLIB=y
# CONFIG_ATMEL_TCB_CLKSRC is not set
CONFIG_SCSI=y
CONFIG_BLK_DEV_SD=y
# CONFIG_SCSI_LOWLEVEL is not set
# CONFIG_INPUT_MOUSEDEV is not set
CONFIG_INPUT_EVDEV=y
CONFIG_VT_HW_CONSOLE_BINDING=y
CONFIG_LEGACY_PTY_COUNT=4
CONFIG_SERIAL_ATMEL=y
CONFIG_SERIAL_ATMEL_CONSOLE=y
# CONFIG_HW_RANDOM is not set
CONFIG_GPIO_SYSFS=y
# CONFIG_HWMON is not set
# CONFIG_HID is not set
# CONFIG_USB_HID is not set
CONFIG_USB=y
CONFIG_USB_ANNOUNCE_NEW_DEVICES=y
CONFIG_USB_EHCI_HCD=y
CONFIG_USB_OHCI_HCD=y
CONFIG_USB_STORAGE=y
CONFIG_MMC=y
# CONFIG_MMC_BLOCK_BOUNCE is not set
CONFIG_SDIO_UART=y
CONFIG_MMC_ATMELMCI=y
CONFIG_DMADEVICES=y
CONFIG_AT_XDMAC=y
# CONFIG_IOMMU_SUPPORT is not set
CONFIG_EXT4_FS=y
CONFIG_EXT4_FS_POSIX_ACL=y
CONFIG_EXT4_FS_SECURITY=y
CONFIG_VFAT_FS=y
CONFIG_TMPFS=y
CONFIG_CONFIGFS_FS=y
CONFIG_UBIFS_FS=y
CONFIG_UBIFS_FS_ADVANCED_COMPR=y
CONFIG_NLS_CODEPAGE_437=y
CONFIG_NLS_CODEPAGE_850=y
CONFIG_NLS_ISO8859_1=y
CONFIG_PRINTK_TIME=y
# CONFIG_SCHED_DEBUG is not set
# CONFIG_FTRACE is not set
CONFIG_DEBUG_USER=y
CONFIG_CRYPTO_ECB=y
CONFIG_CRYPTO_MD5=y
CONFIG_CRYPTO_SHA1_ARM=y
CONFIG_CRYPTO_SHA256=y
CONFIG_CRYPTO_AES_ARM=y
# CONFIG_CRYPTO_ANSI_CPRNG is not set
# CONFIG_CRYPTO_HW is not set
CONFIG_AVERAGE=y
```
