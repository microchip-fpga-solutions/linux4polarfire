## drivers/gpu/drm/microchip/Kconfig
```kconfig
config DRM_MPFS_DPSUB
	tristate "Microchip Display Controller Driver"
	depends on ARCH_MICROCHIP_POLARFIRE || COMPILE_TEST
	depends on COMMON_CLK && DRM && OF
	depends on DMADEVICES
	select DRM_CLIENT_SELECTION
	select DMA_ENGINE
	select VIDEOMODE_HELPERS
	select DRM_DISPLAY_HELPER
	select DRM_BRIDGE_CONNECTOR
	select DRM_GEM_DMA_HELPER
	select DRM_KMS_HELPER
	select GENERIC_PHY
	help
	  This is a DRM/KMS driver for Microchip Display Controller. Choose
	  this option if you have a Microchip Polarfire SoC with Display
	  Controller subsystem.
```

## drivers/media/platform/microchip/Kconfig
```kconfig
config VIDEO_MCHP_DSCMI
	tristate "Microchip Digital Serial Camera Memory Interface Driver"
	depends on V4L_PLATFORM_DRIVERS
	depends on VIDEO_DEV && OF
	select VIDEOBUF2_DMA_CONTIG
	select MEDIA_CONTROLLER
	select VIDEO_V4L2_SUBDEV_API
	select V4L2_FWNODE
	help
	  Microchip Digital Serial Camera Memory Interface Driver Support For Smart Embedded Vision Kit.

config VIDEO_MICROCHIP_COMMON
	tristate
	default n
	help
	  Microchip common code base for FPAG Soft IP drivers.

config VIDEO_MICROCHIP_VIDEO_CAPTURE
	tristate "Microchip Video Capture Driver"
	depends on VIDEO_DEV && OF
	select CONFIG_VIDEO_V4L2_SUBDEV_API
	select VIDEOBUF2_DMA_CONTIG
	select V4L2_FWNODE
	select VIDEO_MICROCHIP_COMMON
	help
	  Microchip Video Capture Driver Support For FPGA Soft IP.

config VIDEO_MICROCHIP_IMAGE_ENHANCEMENT
        tristate "Microchip Video image enhancement"
	depends on VIDEO_DEV && OF
	select CONFIG_VIDEO_V4L2_SUBDEV_API
	select V4L2_FWNODE
	select VIDEO_MICROCHIP_COMMON
        help
          Driver for the Microchip Video image enhancement
```
