/*
 * sama5d4ing.dts - Device Tree file for SAMA5D4 Ingenico devices
 *
 *  Copyright (C) 2013 Ingenico
 *
 * Licensed under GPLv2 or later.
 */
/dts-v1/;
#include "sama5d4.dtsi"
#include "sama5d4ing.dtsi"

/ {
   model = "Ingenico islero";
   compatible = "atmel,sama5d4ing", "atmel,sama5d4", "atmel,sama5";

   chosen {

      /* the default cmdline for DEBUG NFS version */
      bootargs = "console=ttyS0,115200 consoleblank=0 root=/dev/nfs rw nfsroot=10.23.7.56:/home/production/nfs/nfsprXXXX ip=dhcp rootwait ing_security_mod=enable:0";
   };
};

